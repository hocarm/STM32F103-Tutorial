//#include "oled.h"
#include "stm32f1xx_hal.h"
#include "stm32f1xx_hal_gpio.h"
#include "stdlib.h"
//#include "oledfont.h"  	 

#define OLED_CMD  0	
#define OLED_DATA 1	

const unsigned char oled_asc2_1206[95][12]={
{0x00,0x00,0x00,0x00,0x00,0x00,0x00,0x00,0x00,0x00,0x00,0x00},/*" ",0*/
{0x00,0x00,0x00,0x00,0x3F,0x40,0x00,0x00,0x00,0x00,0x00,0x00},/*"!",1*/
{0x00,0x00,0x30,0x00,0x40,0x00,0x30,0x00,0x40,0x00,0x00,0x00},/*""",2*/
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{0x40,0x00,0x80,0x00,0x40,0x00,0x20,0x00,0x20,0x00,0x40,0x00},/*"~",94*/
}; 
const unsigned char oled_asc2_1608[95][16]={	  
{0x00,0x00,0x00,0x00,0x00,0x00,0x00,0x00,0x00,0x00,0x00,0x00,0x00,0x00,0x00,0x00},/*" ",0*/
{0x00,0x00,0x00,0x00,0x00,0x00,0x1F,0xCC,0x00,0x0C,0x00,0x00,0x00,0x00,0x00,0x00},/*"!",1*/
{0x00,0x00,0x08,0x00,0x30,0x00,0x60,0x00,0x08,0x00,0x30,0x00,0x60,0x00,0x00,0x00},/*""",2*/
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{0x00,0x00,0x60,0x00,0x80,0x00,0x80,0x00,0x40,0x00,0x40,0x00,0x20,0x00,0x20,0x00},/*"~",94*/
};  


unsigned char OLED_GRAM[128][8];	


//Write to SSD1306

void OLED_WR_Byte(unsigned char dat,unsigned char cmd)
{	
	unsigned char i;			  
	if(cmd)
	  HAL_GPIO_WritePin(GPIOB,GPIO_PIN_6,1);
	else 
	  HAL_GPIO_WritePin(GPIOB,GPIO_PIN_6,0);		  
//	OLED_CS_Clr();
	for(i=0;i<8;i++)
	{			  
		HAL_GPIO_WritePin(GPIOB,GPIO_PIN_3,0);
		if(dat&0x80)
		   HAL_GPIO_WritePin(GPIOB,GPIO_PIN_4,1);
		else 
		   HAL_GPIO_WritePin(GPIOB,GPIO_PIN_4,0);
		HAL_GPIO_WritePin(GPIOB,GPIO_PIN_3,1);
		dat<<=1;   
	}				 		  
	//OLED_CS_Set();
	HAL_GPIO_WritePin(GPIOB,GPIO_PIN_6,1);   	  
} 

	

void OLED_Refresh_Gram(void)
{
	unsigned char i,n;		    
	for(i=0;i<8;i++)  
	{  
		OLED_WR_Byte (0xb0+i,OLED_CMD);    
		OLED_WR_Byte (0x00,OLED_CMD);      
		OLED_WR_Byte (0x10,OLED_CMD);         
		for(n=0;n<128;n++)OLED_WR_Byte(OLED_GRAM[n][i],OLED_DATA); 
	}   
}


//====================================================  
void OLED_Display_On(void)
{
	OLED_WR_Byte(0X8D,OLED_CMD);  //SET DCDC
	OLED_WR_Byte(0X14,OLED_CMD);  //DCDC ON
	OLED_WR_Byte(0XAF,OLED_CMD);  //DISPLAY ON
}
//==================================================  
void OLED_Display_Off(void)
{
	OLED_WR_Byte(0X8D,OLED_CMD);  //SET DCDC
	OLED_WR_Byte(0X10,OLED_CMD);  //DCDC OFF
	OLED_WR_Byte(0XAE,OLED_CMD);  //DISPLAY OFF
}		   			 
//====================================================  
void OLED_Clear(void)  
{  
	unsigned char i,n;  
	for(i=0;i<8;i++)for(n=0;n<128;n++)OLED_GRAM[n][i]=0X00;  
	OLED_Refresh_Gram();
}
//==========================================			   
void OLED_DrawPoint(unsigned char x,unsigned char y,unsigned char t)
{
	unsigned char pos,bx,temp=0;
	if(x>127||y>63)return;
	pos=7-y/8;
	bx=y%8;
	temp=1<<(7-bx);
	if(t)OLED_GRAM[x][pos]|=temp;
	else OLED_GRAM[x][pos]&=~temp;	    
}
//========================================  
void OLED_Fill(unsigned char x1,unsigned char y1,unsigned char x2,unsigned char y2,unsigned char dot)  
{  
	unsigned char x,y;  
	for(x=x1;x<=x2;x++)
	{
		for(y=y1;y<=y2;y++)OLED_DrawPoint(x,y,dot);
	}													    
	OLED_Refresh_Gram();
}
//=============================== 
void OLED_ShowChar(unsigned char x,unsigned char y,unsigned char chr,unsigned char size,unsigned char mode)
{      			    
	unsigned char temp,t,t1;
	unsigned char y0=y;
	chr=chr-' ';				   
    for(t=0;t<size;t++)
    {   
		if(size==12)temp=oled_asc2_1206[chr][t];  //
		else temp=oled_asc2_1608[chr][t];		 //                
        for(t1=0;t1<8;t1++)
		{
			if(temp&0x80)OLED_DrawPoint(x,y,mode);
			else OLED_DrawPoint(x,y,!mode);
			temp<<=1;
			y++;
			if((y-y0)==size)
			{
				y=y0;
				x++;
				break;
			}
		}  	 
    }          
}
//m^n
unsigned long oled_pow(unsigned char m,unsigned char n)
{
	unsigned long result=1;	 
	while(n--)result*=m;    
	return result;
}				  
///========================================================	 		  
void OLED_ShowNum(unsigned char x,unsigned char y,unsigned long num,unsigned char len,unsigned char size)
{         	
	unsigned char t,temp;
	unsigned char enshow=0;						   
	for(t=0;t<len;t++)
	{
		temp=(num/oled_pow(10,len-t-1))%10;
		if(enshow==0&&t<(len-1))
		{
			if(temp==0)
			{
				OLED_ShowChar(x+(size/2)*t,y,' ',size,1);
				continue;
			}else enshow=1; 
		 	 
		}
	 	OLED_ShowChar(x+(size/2)*t,y,temp+'0',size,1); 
	}
} 
//
//
//
void OLED_ShowString1206(unsigned char x,unsigned char y,const unsigned char *p)
{
#define MAX_CHAR_POSX 122
#define MAX_CHAR_POSY 58          
    while(*p!='\0')
    {       
        if(x>MAX_CHAR_POSX){x=0;y+=16;}
        if(y>MAX_CHAR_POSY){y=x=0;OLED_Clear();}
        OLED_ShowChar(x,y,*p,12,1);	 
        x+=8;
        p++;
    }  
}	 
void OLED_ShowString1608(unsigned char x,unsigned char y,const unsigned char *p)
{
#define MAX_CHAR_POSX 122
#define MAX_CHAR_POSY 58          
    while(*p!='\0')
    {       
        if(x>MAX_CHAR_POSX){x=0;y+=16;}
        if(y>MAX_CHAR_POSY){y=x=0;OLED_Clear();}
        OLED_ShowChar(x,y,*p,16,1);	 
        x+=8;
        p++;
    }  
}
				    
void OLED_Init(void)
{ 	
 
 	  
	
	HAL_GPIO_WritePin(GPIOB,GPIO_PIN_5,0);
	HAL_Delay(100);
	HAL_GPIO_WritePin(GPIOB,GPIO_PIN_5,1); 
					  
	OLED_WR_Byte(0xAE,OLED_CMD); // Xem cac thanh ghi trong datasheet de biet chuc nang
	OLED_WR_Byte(0xD5,OLED_CMD); //
	OLED_WR_Byte(80,OLED_CMD);   //
	OLED_WR_Byte(0xA8,OLED_CMD); //
	OLED_WR_Byte(0X3F,OLED_CMD); //
	OLED_WR_Byte(0xD3,OLED_CMD); //
	OLED_WR_Byte(0X00,OLED_CMD); //

	OLED_WR_Byte(0x40,OLED_CMD); //
													    
	OLED_WR_Byte(0x8D,OLED_CMD); //
	OLED_WR_Byte(0x14,OLED_CMD); //
	OLED_WR_Byte(0x20,OLED_CMD); //
	OLED_WR_Byte(0x02,OLED_CMD); //
	OLED_WR_Byte(0xA1,OLED_CMD); //
	OLED_WR_Byte(0xC0,OLED_CMD); //
	OLED_WR_Byte(0xDA,OLED_CMD); //
	OLED_WR_Byte(0x12,OLED_CMD); //[5:4]
		 
	OLED_WR_Byte(0x81,OLED_CMD); //
	OLED_WR_Byte(0xEF,OLED_CMD); //1~255;
	OLED_WR_Byte(0xD9,OLED_CMD); //
	OLED_WR_Byte(0xf1,OLED_CMD); //[3:0],PHASE 1;[7:4],PHASE 2;
	OLED_WR_Byte(0xDB,OLED_CMD); //
	OLED_WR_Byte(0x30,OLED_CMD); //[6:4] 000,0.65*vcc;001,0.77*vcc;011,0.83*vcc;

	OLED_WR_Byte(0xA4,OLED_CMD); 
	OLED_WR_Byte(0xA6,OLED_CMD);     						   
	OLED_WR_Byte(0xAF,OLED_CMD); 
	OLED_Clear();
}  






