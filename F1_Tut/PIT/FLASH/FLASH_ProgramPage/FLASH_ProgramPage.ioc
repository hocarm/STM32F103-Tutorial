# file: FLASH_ProgramPage.ioc
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Mcu.Family=STM32F1
Mcu.Name=STM32F103C(8-B)Tx
Mcu.Package=LQFP48
NVIC.PriorityGroup=NVIC_PRIORITYGROUP_4
PA13.Mode=Serial_Wire
PA13.Signal=SYS_JTMS-SWDIO
PA14.Mode=Serial_Wire
PA14.Signal=SYS_JTCK-SWCLK
ProjectManager.HeapSize=0x200
ProjectManager.StackSize=0x400
ProjectManager.TargetToolchain=MDK-ARM V5
RCC.APB1Freq_Value=8000000
RCC.APB2Freq_Value=8000000
board=custom

// file: Src/main.c
/* USER CODE BEGIN Header */
/**
  ******************************************************************************
  * @file           : main.c
  * @brief          : Main program body
  ******************************************************************************
  * @attention
  *
  * <h2><center>&copy; Copyright (c) 2019 STMicroelectronics.
  * All rights reserved.</center></h2>
  *
  * This software component is licensed by ST under BSD 3-Clause license,
  * the "License"; You may not use this file except in compliance with the
  * License. You may obtain a copy of the License at:
  *                        opensource.org/licenses/BSD-3-Clause
  *
  ******************************************************************************
  */
	/* --COPYRIGHT--,
	 * Copyright (c) 2019, TAPIT Co., Ltd.
	 * https://tapit.vn
	 * **********************  FLASH_ProgamPage  **********************
	 *  Description: Use Flash library to read and write Flash memory
	 *  Version:    1.0
	 *  Author:     Hang Tran
	 *  Release:    May 27, 2019
	 *  Built with CubeMX Version 5.2.0 and Keil C Version 5.26.2
	 ******************************************************************
	 */
/* USER CODE END Header */

#include "main.h"

/* USER CODE BEGIN Includes */
#include "flash.h"

/* USER CODE END Includes */

/* USER CODE BEGIN PD */
/* Flash define */
#define DATA_START_ADDRESS 		 	((uint32_t)0x0801FC00)	//Page 127
#define LENGTH_START_ADDRESS 		((uint32_t)0x0801F810)	//Page 126
/* USER CODE END PD */

/* USER CODE BEGIN PV */
char data[50] = {0};
int var;

/* USER CODE END PV */

void SystemClock_Config(void);
static void MX_GPIO_Init(void);

int main(void)
{

  /* MCU Configuration--------------------------------------------------------*/

  /* Reset of all peripherals, Initializes the Flash interface and the Systick. */
  HAL_Init();

  /* Configure the system clock */
  SystemClock_Config();

  /* Initialize all configured peripherals */
  MX_GPIO_Init();
  /* USER CODE BEGIN 2 */
	//FLASH_Unlock
	Flash_Unlock();
	//Flash_Erase Page
//	Flash_Erase(DATA_START_ADDRESS);
//	HAL_FLASH_Program(FLASH_TYPEPROGRAM_HALFWORD, DATA_START_ADDRESS, 20);
	var = Flash_Read_Int(DATA_START_ADDRESS);
	if(var == 0xFFFF)
	{
		var = 0;
	}
//	HAL_Delay(2000);
//	Flash_Erase(DATA_START_ADDRESS);
//	HAL_FLASH_Program(FLASH_TYPEPROGRAM_HALFWORD, DATA_START_ADDRESS, 30);
//	var = Flash_Read_Int(DATA_START_ADDRESS);
//	Flash_ProgramPage("First data written to flash",DATA_START_ADDRESS,LENGTH_START_ADDRESS);
//	Flash_ReadChar(data,DATA_START_ADDRESS,LENGTH_START_ADDRESS);
//	HAL_Delay(2000);
//	Flash_ProgramPage("New data after start",DATA_START_ADDRESS,LENGTH_START_ADDRESS);
//	Flash_ReadChar(data,DATA_START_ADDRESS,LENGTH_START_ADDRESS);
//	HAL_Delay(2000);
//	Flash_ProgramPage("New data",DATA_START_ADDRESS,LENGTH_START_ADDRESS);
//	Flash_ReadChar(data,DATA_START_ADDRESS,LENGTH_START_ADDRESS);

  /* USER CODE END 2 */

  /* Infinite loop */
  while (1)
  {

  }
}

void SystemClock_Config(void)
{
  RCC_OscInitTypeDef RCC_OscInitStruct = {0};
  RCC_ClkInitTypeDef RCC_ClkInitStruct = {0};

  /** Initializes the CPU, AHB and APB busses clocks
  */
  RCC_OscInitStruct.OscillatorType = RCC_OSCILLATORTYPE_HSI;
  RCC_OscInitStruct.HSIState = RCC_HSI_ON;
  RCC_OscInitStruct.HSICalibrationValue = RCC_HSICALIBRATION_DEFAULT;
  RCC_OscInitStruct.PLL.PLLState = RCC_PLL_NONE;
  if (HAL_RCC_OscConfig(&RCC_OscInitStruct) != HAL_OK)
  {
    Error_Handler();
  }
  /** Initializes the CPU, AHB and APB busses clocks
  */
  RCC_ClkInitStruct.ClockType = RCC_CLOCKTYPE_HCLK|RCC_CLOCKTYPE_SYSCLK
                              |RCC_CLOCKTYPE_PCLK1|RCC_CLOCKTYPE_PCLK2;
  RCC_ClkInitStruct.SYSCLKSource = RCC_SYSCLKSOURCE_HSI;
  RCC_ClkInitStruct.AHBCLKDivider = RCC_SYSCLK_DIV1;
  RCC_ClkInitStruct.APB1CLKDivider = RCC_HCLK_DIV1;
  RCC_ClkInitStruct.APB2CLKDivider = RCC_HCLK_DIV1;

  if (HAL_RCC_ClockConfig(&RCC_ClkInitStruct, FLASH_LATENCY_0) != HAL_OK)
  {
    Error_Handler();
  }
}

static void MX_GPIO_Init(void)
{

  /* GPIO Ports Clock Enable */
  __HAL_RCC_GPIOA_CLK_ENABLE();

}

void Error_Handler(void)
{
}

/************************ (C) COPYRIGHT STMicroelectronics *****END OF FILE****/
